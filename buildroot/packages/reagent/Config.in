## buildroot/packages/reagent/Config.in
```kconfig
config BR2_PACKAGE_REAGENT
        bool "reagent"
        help
          A daemon running on edge devices to establish a connection to the IronFlock router and manage apps and containers.
          
          https://github.com/RecordEvolution/DeviceManagementAgent
```

## buildroot/packages/shadow/Config.in
```kconfig
config BR2_PACKAGE_SHADOW
        bool "shadow"
        help
          Password and account management tool suite with support for shadow files and PAM.
          
          https://github.com/shadow-maint/shadow
```
